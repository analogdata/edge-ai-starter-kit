// EdgeAI starter kit: offline voice commands on an ESP32.
// Mic -> 1 s rolling buffer -> log-mel features -> tiny int8 CNN -> action.
// Nothing leaves the chip. No Wi-Fi is even turned on.

#include <math.h>
#include <stdio.h>
#include <string.h>

#include "driver/gpio.h"
#include "driver/i2s_std.h"
#include "esp_heap_caps.h"
#include "esp_log.h"
#include "esp_timer.h"
#include "freertos/FreeRTOS.h"
#include "freertos/task.h"

#include "tensorflow/lite/micro/micro_interpreter.h"
#include "tensorflow/lite/micro/micro_mutable_op_resolver.h"
#include "tensorflow/lite/schema/schema_generated.h"

#include "board_config.h"
#include "features.h"
#include "kws_config.h"   // generated by train/train.py
#include "model_data.h"   // generated by train/train.py

static const char *TAG = "edgeai";

#define HOP_SAMPLES 4000   // run the model every 250 ms
static int16_t s_audio[KWS_CLIP_SAMPLES];  // rolling 1 s window, oldest first
static float s_feat[KWS_NUM_FRAMES * KWS_NUM_MEL];

static i2s_chan_handle_t s_rx;

static void mic_init(void) {
    i2s_chan_config_t chan_cfg = I2S_CHANNEL_DEFAULT_CONFIG(I2S_NUM_AUTO, I2S_ROLE_MASTER);
    ESP_ERROR_CHECK(i2s_new_channel(&chan_cfg, NULL, &s_rx));

    i2s_std_config_t cfg = {};
    cfg.clk_cfg = I2S_STD_CLK_DEFAULT_CONFIG(KWS_SAMPLE_RATE);
    cfg.slot_cfg = I2S_STD_PHILIPS_SLOT_DEFAULT_CONFIG(I2S_DATA_BIT_WIDTH_32BIT, I2S_SLOT_MODE_MONO);
    cfg.slot_cfg.slot_mask = I2S_STD_SLOT_LEFT;
    cfg.gpio_cfg.mclk = I2S_GPIO_UNUSED;
    cfg.gpio_cfg.bclk = (gpio_num_t)PIN_I2S_BCLK;
    cfg.gpio_cfg.ws = (gpio_num_t)PIN_I2S_WS;
    cfg.gpio_cfg.dout = I2S_GPIO_UNUSED;
    cfg.gpio_cfg.din = (gpio_num_t)PIN_I2S_DIN;
    ESP_ERROR_CHECK(i2s_channel_init_std_mode(s_rx, &cfg));
    ESP_ERROR_CHECK(i2s_channel_enable(s_rx));
}

// Read exactly HOP_SAMPLES new samples and slide them into the 1 s window.
static void read_hop(void) {
    static int32_t raw[512];
    static int16_t hop[HOP_SAMPLES];  // static: 8 KB is too big for the main task stack
    int got = 0;
    while (got < HOP_SAMPLES) {
        size_t bytes = 0;
        int want = HOP_SAMPLES - got;
        if (want > 512) want = 512;
        if (i2s_channel_read(s_rx, raw, want * sizeof(int32_t), &bytes, portMAX_DELAY) != ESP_OK) continue;
        int n = bytes / sizeof(int32_t);
        for (int i = 0; i < n; i++) {
            int32_t v = raw[i] >> MIC_SHIFT;
            if (v > 32767) v = 32767;
            if (v < -32768) v = -32768;
            hop[got + i] = (int16_t)v;
        }
        got += n;
    }
    memmove(s_audio, s_audio + HOP_SAMPLES, (KWS_CLIP_SAMPLES - HOP_SAMPLES) * sizeof(int16_t));
    memcpy(s_audio + KWS_CLIP_SAMPLES - HOP_SAMPLES, hop, sizeof(hop));
}

static int rms_of_window(void) {
    double acc = 0;
    for (int i = 0; i < KWS_CLIP_SAMPLES; i++) acc += (double)s_audio[i] * s_audio[i];
    return (int)sqrt(acc / KWS_CLIP_SAMPLES);
}

static void on_command(const char *word) {
    // This is where YOUR project starts. Swap the LED for a relay, a motor, a lamp...
    if (strcmp(word, "on") == 0) gpio_set_level((gpio_num_t)PIN_LED, 1);
    if (strcmp(word, "off") == 0) gpio_set_level((gpio_num_t)PIN_LED, 0);
}

extern "C" void app_main(void) {
    gpio_reset_pin((gpio_num_t)PIN_LED);
    gpio_set_direction((gpio_num_t)PIN_LED, GPIO_MODE_OUTPUT);
    gpio_set_level((gpio_num_t)PIN_LED, 0);

    features_init();
    mic_init();

    // --- load the model ---
    const tflite::Model *model = tflite::GetModel(g_kws_model);
    if (model->version() != TFLITE_SCHEMA_VERSION) {
        ESP_LOGE(TAG, "Model schema %lu != supported %d", (unsigned long)model->version(), TFLITE_SCHEMA_VERSION);
        return;
    }
    static tflite::MicroMutableOpResolver<5> resolver;
    resolver.AddConv2D();
    resolver.AddDepthwiseConv2D();
    resolver.AddFullyConnected();
    resolver.AddMean();
    resolver.AddSoftmax();

    uint8_t *arena = (uint8_t *)heap_caps_malloc(TENSOR_ARENA_BYTES, MALLOC_CAP_8BIT);
    if (!arena) { ESP_LOGE(TAG, "No RAM for tensor arena"); return; }
    static tflite::MicroInterpreter interp(model, resolver, arena, TENSOR_ARENA_BYTES);
    if (interp.AllocateTensors() != kTfLiteOk) {
        ESP_LOGE(TAG, "AllocateTensors failed. Raise TENSOR_ARENA_BYTES in board_config.h");
        return;
    }
    TfLiteTensor *in = interp.input(0);
    TfLiteTensor *out = interp.output(0);
    const float in_scale = in->params.scale;
    const int in_zp = in->params.zero_point;
    const float out_scale = out->params.scale;
    const int out_zp = out->params.zero_point;
    ESP_LOGI(TAG, "Model ready. Arena used: %u bytes. Say: on, off, yes, no, up, down, stop, go",
             (unsigned)interp.arena_used_bytes());

    int streak = 0, last = -1;
    int64_t quiet_until = 0;

    while (true) {
        read_hop();
        if (rms_of_window() < MIN_RMS) { streak = 0; last = -1; continue; }

        int64_t t0 = esp_timer_get_time();
        features_compute(s_audio, s_feat);
        for (int i = 0; i < KWS_NUM_FRAMES * KWS_NUM_MEL; i++) {
            int q = (int)lroundf(s_feat[i] / in_scale) + in_zp;
            in->data.int8[i] = (int8_t)(q < -128 ? -128 : q > 127 ? 127 : q);
        }
        if (interp.Invoke() != kTfLiteOk) { ESP_LOGE(TAG, "Invoke failed"); continue; }

        int best = 0;
        float best_p = -1.0f;
        for (int i = 0; i < KWS_NUM_LABELS; i++) {
            float p = (out->data.int8[i] - out_zp) * out_scale;
            if (p > best_p) { best_p = p; best = i; }
        }
        int ms = (int)((esp_timer_get_time() - t0) / 1000);
        ESP_LOGD(TAG, "%s %.2f (%d ms)", KWS_LABELS[best], best_p, ms);

        const char *name = KWS_LABELS[best];
        bool is_word = name[0] != '_';   // skip _silence_ and _unknown_
        if (is_word && best_p >= CONFIDENCE) {
            streak = (best == last) ? streak + 1 : 1;
            last = best;
            if (streak >= CONFIRMATIONS && esp_timer_get_time() > quiet_until) {
                ESP_LOGI(TAG, "%s (%.0f%% sure, %d ms per inference)", name, best_p * 100, ms);
                on_command(name);
                quiet_until = esp_timer_get_time() + 1000000;  // 1 s cooldown
                streak = 0;
            }
        } else {
            streak = 0;
            last = -1;
        }
    }
}
